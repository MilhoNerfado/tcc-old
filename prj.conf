## CMakeLists.txt
```
# SPDX-License-Identifier: Apache-2.0

cmake_minimum_required(VERSION 3.20.0)

set(BOARD nucleo_g031k8)

find_package(Zephyr REQUIRED HINTS $ENV{ZEPHYR_BASE})
project(tcc)

target_sources(app PRIVATE src/main.c)

add_subdirectory(src/drivers)
```

## Kconfig
```
menu "Zephyr"
source "Kconfig.zephyr"
endmenu

rsource "src/Kconfig"
```

## prj.conf
```kconfig
CONFIG_SHELL=y
CONFIG_SHELL_MINIMAL=y

CONFIG_GPIO=y

CONFIG_RELAY_LEN=3
```

## boards/nucleo_g031k8.overlay
```dts
/*
 * Copyright (c) 2023 Martin Jäger / Libre Solar
 *
 * SPDX-License-Identifier: Apache-2.0
 */

/ {
	relay: relay_config {
		compatible = "relay";

		enable-gpios = <&gpioa 5 GPIO_ACTIVE_HIGH>;
		clock-gpios = <&gpioa 6 GPIO_ACTIVE_HIGH>;
		data-gpios = <&gpioa 7 GPIO_ACTIVE_HIGH>;
		//		reset-gpios = <&gpioa 8 GPIO_ACTIVE_HIGH>;


	};
};
```

## dts/bindings/magic.yaml
```yaml
# Copyright (c) 2023 Libre Solar Technologies GmbH
# SPDX-License-Identifier: Apache-2.0

description: GPIO pin to switch a power output on or off

compatible: "magic"

properties:
  gpios:
    type: phandle-array
    required: true
    description: |
      The GPIO connected to the gate driver for the MOSFET.
```

## dts/bindings/relay.yaml
```yaml
# Copyright (c) 2023 Libre Solar Technologies GmbH
# SPDX-License-Identifier: Apache-2.0

description: GPIO pin to switch a power output on or off

compatible: "relay"

properties:
  enable-gpios:
    type: phandle-array
    required: true
    description: |
      Relay Enable.
  clock-gpios:
    type: phandle-array
    required: true
    description: |
      Relay Clock.
  data-gpios:
    type: phandle-array
    required: true
    description: |
      Relay Data.
  reset-gpios:
    type: phandle-array
    required: false
    description: |
      Relay Reset.
  
  
```

## src/main.c
```c
/*
 * Copyright (c) 2012-2014 Wind River Systems, Inc.
 *
 * SPDX-License-Identifier: Apache-2.0
 */

#include <stdio.h>

#include <zephyr/devicetree.h>
#include <zephyr/sys/printk.h>

#include "drivers/mutex/mutex.h"

int main(void)
{
	int err;

	err = mutex_init();

	if (err != 0) {
		printk("Failed to init the mutex driver");
		return -1;
	}

	return 0;
}

static int cmd_mutex_clear(void)
{
	return mutex_set(0);
}
```
